## ZMK source code/p9981/Kconfig.board
```kconfig
# Copyright (c) 2023 ZitaoTech
# SPDX-License-Identifier: MIT

config BOARD_P9981
    bool "p9981"
    depends on SOC_NRF52840_QIAA
```

## ZMK source code/p9981/Kconfig.defconfig
```kconfig
# Copyright (c) 2025 ZitaoTech
# SPDX-License-Identifier: MIT

if BOARD_P9981

config ZMK_KEYBOARD_NAME
    default "p9981"

if USB_DEVICE_STACK

config USB_NRFX
    default y

endif # USB_DEVICE_STACK

if ZMK_BACKLIGHT

config PWM
    default y

config LED_PWM
    default y

endif # ZMK_BACKLIGHT

config BT_CTLR
    default BT

endif # BOARD_P9981
```
